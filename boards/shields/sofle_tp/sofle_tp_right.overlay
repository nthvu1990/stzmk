/*
 * Copyright (c) 2020 Ryan Cross
 *
 * SPDX-License-Identifier: MIT
 */

#include "sofle_tp.dtsi"

&default_transform {
    col-offset = <6>;
};

&kscan0 {
    col-gpios
        = <&pro_micro 10 GPIO_ACTIVE_HIGH>
        , <&pro_micro 16 GPIO_ACTIVE_HIGH>
        , <&pro_micro 14 GPIO_ACTIVE_HIGH>
        , <&pro_micro 15 GPIO_ACTIVE_HIGH>
        , <&pro_micro 18 GPIO_ACTIVE_HIGH>
        , <&pro_micro 19 GPIO_ACTIVE_HIGH>
        ;
};

// Pick the driver
#define MOUSE_PS2_DRIVER_UART

// Configure the data (use mosi) and clock (use sck) pins
#define MOUSE_PS2_PIN_SCL_PRO_MICRO <&pro_micro 21 GPIO_ACTIVE_HIGH>
#define MOUSE_PS2_PIN_SDA_PRO_MICRO <&pro_micro 20 GPIO_ACTIVE_HIGH>
#define MOUSE_PS2_PIN_SDA_PINCTRL <NRF_PSEL(UART_RX, 0, 29)>

// Configure the power-on-reset pin (use cs)
#define MOUSE_PS2_PIN_RST_PRO_MICRO <&pro_micro 4 GPIO_ACTIVE_HIGH>

// Pull in the additional trackpoint configs that you usually do not need to touch
#include "includes/_trackpoint_overlay.dtsi"

// Configure trackpoint rotation
&mouse_ps2_input_listener {
    x-invert;
};
